## target/linux/omap/image/Config.in
```kconfig
config OMAP_SD_BOOT_PARTSIZE
	int "Boot (SD Card) filesystem partition size (in MB)"
	depends on TARGET_omap
	default 20

config TARGET_NVRAM_PARTSIZE
	int "NVRAM filesystem partition size (in MB)"
	depends on TARGET_omap
	default 10
```
